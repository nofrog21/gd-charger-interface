## Kconfig
```kconfig
mainmenu "Charger Interface Configuration"
source "components/Kconfig"
source "gd_system/Kconfig"
```

## components/Kconfig
```kconfig
menu "Components"
source "components/charger_driver/Kconfig"
source "components/rs485/Kconfig"
endmenu
```

## components/charger_driver/Kconfig
```kconfig
menu "Charger Driver Configuration"

     choice CHARGER_TARGET
            prompt "Set target for charger driver"
            default CHARGER_TARGET_DX1230
            help
                This option sets driver for charger

            config CHARGER_TARGET_DX1230
                bool "Driver for TBB DX1230"
            config CHARGER_TARGET_MDX
                bool "Driver for TBB MDX1360 or MDX1260"
     endchoice
endmenu
```

## components/rs485/Kconfig
```kconfig
menu "RS485"
     choice RS485_USART
         prompt "Set USART port"
         default RS485_USART0
         help
             This option sets USART port used to interact with GD32 HAL
         config RS485_USART0
             bool "USART0"
         config RS485_USART1
             bool "USART1"
     endchoice
     config RS485_PIN_DE
         int "PIN_DE" 
     config RS485_PIN_RE
         int "PIN_RE"
endmenu
```

## gd_system/Kconfig
```kconfig
menu "GigaDevice Configuration"
     choice GD_TARGET
            prompt "Set target MC"
            default GD_TARGET_GD32F303
            help
                This option sets target MC
            config GD_TARGET_GD32F303
                bool "GD32F303 mc family"
            config GD_TARGET_GD32F305
                bool "GD32F305 mc family"
            config GD_TARGET_GD32F103
                bool "GD32F103 mc family"
      endchoice
endmenu
```
